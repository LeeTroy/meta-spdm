## conf/layer.conf
```bitbake
# We have a conf and classes directory, add to BBPATH
BBPATH .= ":${LAYERDIR}"

# We have recipes-* directories, add to BBFILES
BBFILES += "${LAYERDIR}/recipes-*/*/*.bb \
            ${LAYERDIR}/recipes-*/*/*.bbappend"

BBFILE_COLLECTIONS += "meta-spdm"
BBFILE_PATTERN_meta-spdm = "^${LAYERDIR}/"
BBFILE_PRIORITY_meta-spdm = "6"

LAYERDEPENDS_meta-spdm = "core"
LAYERSERIES_COMPAT_meta-spdm = "kirkstone langdale"
```
